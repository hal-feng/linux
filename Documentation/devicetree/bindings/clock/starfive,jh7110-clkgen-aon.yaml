## Documentation/devicetree/bindings/clock/starfive,jh7110-clkgen-aon.yaml
```yaml
# SPDX-License-Identifier: GPL-2.0-only OR BSD-2-Clause
%YAML 1.2
---
$id: http://devicetree.org/schemas/clock/starfive,jh7110-clkgen-aon.yaml#
$schema: http://devicetree.org/meta-schemas/core.yaml#

title: StarFive JH7110 Always-On Clock Generator

maintainers:
  - Emil Renner Berthing <kernel@esmil.dk>
  - Xingyu Wu <xingyu.wu@linux.starfivetech.com>

properties:
  compatible:
    const: starfive,jh7110-clkgen-aon

  clocks:
    items:
      - description: Main Oscillator
      - description: RTC clock
      - description: RMII reference clock
      - description: RGMII RX clock
      - description: STG AXI/AHB clock
      - description: APB Bus clock

  clock-names:
    items:
      - const: osc
      - const: clk_rtc
      - const: gmac0_rmii_refin
      - const: gmac0_rgmii_rxin
      - const: stg_axiahb
      - const: apb_bus_func

  '#clock-cells':
    const: 1
    description:
      See <dt-bindings/clock/starfive-jh7110-aon.h> for valid indices.

required:
  - compatible
  - clocks
  - clock-names
  - '#clock-cells'

additionalProperties: false

examples:
  - |
    #include <dt-bindings/clock/starfive-jh7110-sys.h>

    aoncrg: clock-controller@17000000 {
        compatible = "starfive,jh7110-aoncrg";
        clocks = <&osc>, <&clk_rtc>,
                 <&gmac0_rmii_refin>, <&gmac0_rgmii_rxin>,
                 <&syscrg JH7110_SYSCLK_STG_AXIAHB>,
                 <&syscrg JH7110_SYSCLK_APB_BUS_FUNC>;
        clock-names = "osc", "clk_rtc",
                      "gmac0_rmii_refin", "gmac0_rgmii_rxin",
                      "stg_axiahb", "apb_bus_func";
        #clock-cells = <1>;
    };
```

## Documentation/devicetree/bindings/clock/starfive,jh7110-clkgen-sys.yaml
```yaml
# SPDX-License-Identifier: GPL-2.0-only OR BSD-2-Clause
%YAML 1.2
---
$id: http://devicetree.org/schemas/clock/starfive,jh7110-clkgen-sys.yaml#
$schema: http://devicetree.org/meta-schemas/core.yaml#

title: StarFive JH7110 System Clock Generator

maintainers:
  - Emil Renner Berthing <kernel@esmil.dk>
  - Xingyu Wu <xingyu.wu@linux.starfivetech.com>

properties:
  compatible:
    const: starfive,jh7110-clkgen-sys

  clocks:
    items:
      - description: Main Oscillator (24 MHz)
      - description: RMII reference clock
      - description: RGMII RX clock
      - description: I2S TX bit clock
      - description: I2S TX left/right clock
      - description: I2S RX bit clock
      - description: I2S RX left/right clock
      - description: TDM
      - description: mclk

  clock-names:
    items:
      - const: osc
      - const: gmac1_rmii_refin
      - const: gmac1_rgmii_rxin
      - const: i2stx_bclk_ext
      - const: i2stx_lrck_ext
      - const: i2srx_bclk_ext
      - const: i2srx_lrck_ext
      - const: tdm_ext
      - const: mclk_ext

  '#clock-cells':
    const: 1
    description:
      See <dt-bindings/clock/starfive-jh7110-sys.h> for valid indices.

required:
  - compatible
  - clocks
  - clock-names
  - '#clock-cells'

additionalProperties: false

examples:
  - |
    syscrg_clk: clock-controller@13020000 {
        compatible = "starfive,jh7110-clkgen-sys";
        clocks = <&osc>, <&gmac1_rmii_refin>,
                 <&gmac1_rgmii_rxin>,
                 <&i2stx_bclk_ext>, <&i2stx_lrck_ext>,
                 <&i2srx_bclk_ext>, <&i2srx_lrck_ext>,
                 <&tdm_ext>, <&mclk_ext>;
        clock-names = "osc", "gmac1_rmii_refin",
                      "gmac1_rgmii_rxin",
                      "i2stx_bclk_ext", "i2stx_lrck_ext",
                      "i2srx_bclk_ext", "i2srx_lrck_ext",
                      "tdm_ext", "mclk_ext";
        #clock-cells = <1>;
    };
```

## Documentation/devicetree/bindings/pinctrl/starfive,jh7110-pinctrl.yaml
```yaml
# SPDX-License-Identifier: GPL-2.0-only OR BSD-2-Clause
%YAML 1.2
---
$id: http://devicetree.org/schemas/pinctrl/starfive,jh7110-pinctrl.yaml#
$schema: http://devicetree.org/meta-schemas/core.yaml#

title: StarFive JH7110 Pin Controller Device Tree Bindings

description: |
  Bindings for the JH7110 RISC-V SoC from StarFive Technology Ltd.

maintainers:
  - Jianlong Huang <jianlong.huang@starfivetech.com>

properties:
  compatible:
    enum:
    - starfive,jh7110-sys-pinctrl
    - starfive,jh7110-aon-pinctrl

  reg:
    minItems: 2
    maxItems: 2

  reg-names:
    items:
      - const: control

  clocks:
    maxItems: 1

  resets:
    maxItems: 1

  "#gpio-cells":
    const: 2

  interrupts:
    maxItems: 1
    description: The GPIO parent interrupt.

  interrupt-controller: true

  "#interrupt-cells":
    const: 2

  ngpios:
    enum:
    - 64
    - 4

required:
  - compatible
  - reg
  - reg-names
  - clocks
  - "#gpio-cells"
  - interrupts
  - interrupt-controller
  - "#interrupt-cells"

patternProperties:
  '-[0-9]+$':
    type: object
    patternProperties:
      '-pins$':
        type: object
        description: |
          A pinctrl node should contain at least one subnode representing the
          pinctrl groups available on the machine. Each subnode will list the
          pins it needs, and how they should be configured, with regard to
          muxer configuration, system signal configuration, pin groups for
          vin/vout module, pin voltage, mux functions for output, mux functions
          for output enable, mux functions for input.

        properties:
          starfive,pins:
            description: |
              The list of pin identifiers that properties in the node apply to.
              This should be set using the PAD_GPIOX macros.
              This has to be specified.
            $ref: /schemas/types.yaml#/definitions/uint32
            minimum: 0
            maximum: 63

          starfive,pinmux:
            description: |
              The list of GPIOs and their mux functions that properties in the
              node apply to. This should be set using the PAD_GPIOX_FUNC_SEL
              macro with its value.
              This is optional for some pins.
              The value of PAD_GPIOX_FUNC_SEL macro can selects:
                0: GPIOX mux function 0,
                1: GPIOX mux function 1,
                2: GPIOX mux function 2.

          starfive,pin-ioconfig:
            description: |
              This is used to configure the core settings of system signals.
              The combination of GPIO_IE or GPIO_DS or GPIO_PU or GPIO_PD or
              GPIO_SLEW or GPIO_SMT or GPIO_POS.
            $ref: /schemas/types.yaml#/definitions/uint32

          starfive,padmux:
            description: |
              The padmux is for vin/vout module to select pin groups.
              0: vout will be set at pins from PAD_GPIO7 to PAD_GPIO34,
                 when PAD_GPIOX_FUNC_SEL is set as 1.
                 vin will be set at pins from PAD_GPIO6 to PAD_GPIO20.
                 when PAD_GPIOX_FUNC_SEL is set as 2.
              1: vout will be set at pins from PAD_GPIO36 to PAD_GPIO63,
                 when PAD_GPIOX_FUNC_SEL is set as 1.
                 vin will be set at pins from PAD_GPIO21 to PAD_GPIO35.
                 when PAD_GPIOX_FUNC_SEL is set as 2.
              2: vin will be set at pins from PAD_GPIO36 to PAD_GPIO50,
                 when PAD_GPIOX_FUNC_SEL is set as 2
            $ref: /schemas/types.yaml#/definitions/uint32
            enum: [0, 1, 2]

          starfive,pin-syscon:
            description: |
              This is used to set pin voltage,
              0: 3.3V, 1: 2.5V, 2: 1.8V.
            $ref: /schemas/types.yaml#/definitions/uint32
            enum: [0, 1, 2]

          starfive,pin-gpio-dout:
            description: |
              This is used to set their mux functions for output.
              This should be set using the GPO_XXX macro,
              such as GPO_LOW, GPO_UART0_SOUT.
            $ref: /schemas/types.yaml#/definitions/uint32
            minimum: 0
            maximum: 107

          starfive,pin-gpio-doen:
            description: |
              This is used to set their mux functions for output enable.
              This should be set using the OEN_XXX macro,
              such as OEN_LOW, OEN_I2C0_IC_CLK_OE.
            $ref: /schemas/types.yaml#/definitions/uint32
            minimum: 0
            maximum: 49

          starfive,pin-gpio-din:
            description: |
              This is used to set their mux functions for input.
              This should be set using the GPI_XXX macro,
              such as GPI_CAN0_CTRL_RXD, GPI_I2C0_IC_CLK_IN_A.
            $ref: /schemas/types.yaml#/definitions/uint32
            minimum: 0
            maximum: 90

        additionalProperties: false

    additionalProperties: false

additionalProperties: false

examples:
  - |
    #include <dt-bindings/clock/starfive-jh7110-sys.h>
    #include <dt-bindings/reset/starfive-jh7110.h>
    #include <dt-bindings/pinctrl/pinctrl-starfive-jh7110.h>

    gpio: gpio@13040000 {
      compatible = "starfive,jh7110-sys-pinctrl";
      reg = <0x0 0x13040000 0x0 0x10000>;
      reg-names = "control";
      clocks = <&clkgen JH7110_SYS_IOMUX_PCLK>;
      resets = <&rstgen RSTN_U0_SYS_IOMUX_PRESETN>;
      interrupts = <86>;
      interrupt-controller;
      #gpio-cells = <2>;
      ngpios = <64>;
      status = "okay";

      uart0_pins: uart0-pins {
        uart0-pins-tx {
          starfive,pins = <PAD_GPIO5>;
          starfive,pin-ioconfig = <IO(GPIO_IE(1) | GPIO_DS(3))>;
          starfive,pin-gpio-dout = <GPO_UART0_SOUT>;
          starfive,pin-gpio-doen = <OEN_LOW>;
        };

        uart0-pins-rx {
          starfive,pins = <PAD_GPIO6>;
          starfive,pinmux = <PAD_GPIO6_FUNC_SEL 0>;
          starfive,pin-ioconfig = <IO(GPIO_IE(1) | GPIO_PU(1))>;
          starfive,pin-gpio-doen = <OEN_HIGH>;
          starfive,pin-gpio-din =  <GPI_UART0_SIN>;
        };
      };
    };

    &uart0 {
      pinctrl-names = "default";
      pinctrl-0 = <&uart0_pins>;
      status = "okay";
    };

...
```

## Documentation/devicetree/bindings/reset/starfive,jh7100-reset.yaml
```yaml
# SPDX-License-Identifier: GPL-2.0-only OR BSD-2-Clause
%YAML 1.2
---
$id: http://devicetree.org/schemas/reset/starfive,jh7100-reset.yaml#
$schema: http://devicetree.org/meta-schemas/core.yaml#

title: StarFive JH7100 SoC Reset Controller Device Tree Bindings

maintainers:
  - Emil Renner Berthing <kernel@esmil.dk>

properties:
  compatible:
    enum:
      - starfive,jh7100-reset

  reg:
    maxItems: 1

  "#reset-cells":
    const: 1

  starfive,assert-offset:
    description: Offset of the first ASSERT register
    $ref: /schemas/types.yaml#/definitions/uint32

  starfive,status-offset:
    description: Offset of the first STATUS register
    $ref: /schemas/types.yaml#/definitions/uint32

  starfive,nr-resets:
    description: Number of reset signals
    $ref: /schemas/types.yaml#/definitions/uint32

required:
  - compatible
  - reg
  - "#reset-cells"
  - starfive,assert-offset
  - starfive,status-offset
  - starfive,nr-resets

additionalProperties: false

examples:
  - |
    #include <dt-bindings/reset/starfive-jh7100.h>

    reset-controller@11840000 {
        compatible = "starfive,jh7100-reset";
        reg = <0x11840000 0x10000>;
        #reset-cells = <1>;
        starfive,assert-offset = <0x0>;
        starfive,status-offset= <0x10>;
        starfive,nr-resets = <JH7100_RSTN_END>;
    };

...
```

## Documentation/devicetree/bindings/reset/starfive,jh7110-reset.yaml
```yaml
# SPDX-License-Identifier: GPL-2.0-only OR BSD-2-Clause
%YAML 1.2
---
$id: http://devicetree.org/schemas/reset/starfive,jh7110-reset.yaml#
$schema: http://devicetree.org/meta-schemas/core.yaml#

title: StarFive JH7110 SoC Reset Controller Device Tree Bindings

maintainers:
  - Emil Renner Berthing <kernel@esmil.dk>
  - Hal Feng <hal.feng@linux.starfivetech.com>

properties:
  compatible:
    enum:
      - starfive,jh7110-reset

  "#reset-cells":
    const: 1

  starfive,assert-offset:
    description: Offset of the first ASSERT register
    $ref: /schemas/types.yaml#/definitions/uint32

  starfive,status-offset:
    description: Offset of the first STATUS register
    $ref: /schemas/types.yaml#/definitions/uint32

  starfive,nr-resets:
    description: Number of reset signals
    $ref: /schemas/types.yaml#/definitions/uint32

required:
  - compatible
  - "#reset-cells"
  - starfive,assert-offset
  - starfive,status-offset
  - starfive,nr-resets

additionalProperties: false

examples:
  - |
    #include <dt-bindings/reset/starfive-jh7110.h>

    syscrg_rst: reset-controller@13020000 {
        compatible = "starfive,jh7110-reset";
        #reset-cells = <1>;
        starfive,assert-offset = <0x2F8>;
        starfive,status-offset= <0x308>;
        starfive,nr-resets = <JH7110_SYSRST_END>;
    };

...
```

## drivers/clk/starfive/Kconfig
```kconfig
# SPDX-License-Identifier: GPL-2.0

config CLK_STARFIVE
	bool

config CLK_STARFIVE_JH7100
	bool "StarFive JH7100 clock support"
	depends on SOC_STARFIVE || COMPILE_TEST
	select CLK_STARFIVE
	default SOC_STARFIVE
	help
	  Say yes here to support the clock controller on the StarFive JH7100
	  SoC.

config CLK_STARFIVE_JH7100_AUDIO
	tristate "StarFive JH7100 audio clock support"
	depends on SOC_STARFIVE || COMPILE_TEST
	select CLK_STARFIVE
	default m if SOC_STARFIVE
	help
	  Say Y or M here to support the audio clocks on the StarFive JH7100
	  SoC.

config CLK_STARFIVE_JH7110_SYS
	bool "StarFive JH7110 system clock support"
	depends on SOC_STARFIVE || COMPILE_TEST
	select CLK_STARFIVE
	default SOC_STARFIVE
	help
	  Say yes here to support the system clock controller on the
	  StarFive JH7110 SoC.

config CLK_STARFIVE_JH7110_AON
	tristate "StarFive JH7110 always-on clock support"
	depends on SOC_STARFIVE || COMPILE_TEST
	select CLK_STARFIVE
	default m if SOC_STARFIVE
	help
	  Say yes here to support the always-on clock controller on the
	  StarFive JH7110 SoC.
```
